## src/drivers/rc/crsf_rc/Kconfig
```kconfig
menuconfig DRIVERS_RC_CRSF_RC
	bool "crsf_rc"
	default n
	---help---
		Enable support for crsf rc

config RC_CRSF_INJECT
	depends on DRIVERS_RC_CRSF_RC
	bool "Inject CRSF RC"
	default n
	---help---
		Enable this to inject CRSF RC commands.
```

## src/systemcmds/serial_config/Kconfig
```kconfig
menuconfig SYSTEMCMDS_SERIAL_CONFIG
	bool "serial_config"
	default y
	depends on PLATFORM_NUTTX && ARCH_CHIP_STM32H7
	depends on BOARD_ROMFSROOT != ""
	---help---
		Apply SER_*_SWAP before starting an automatically configured serial service.
		Currently supported on STM32H7, where the UART driver preserves SWAP across
		close/reopen. The NuttX configuration must enable STM32H7_USART_SWAP.
		Enabled by default for supported firmware targets, excluding bootloaders.
		This command does not run a background task.
```
